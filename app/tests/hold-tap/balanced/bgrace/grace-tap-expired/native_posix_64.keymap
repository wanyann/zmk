#include <dt-bindings/zmk/keys.h>
#include <behaviors.dtsi>
#include <dt-bindings/zmk/kscan_mock.h>
#include "../behavior_keymap.dtsi"

&kscan {
    events = <
        ZMK_MOCK_PRESS(0,0,10)  // hold-tap key
        ZMK_MOCK_PRESS(1,0,10)  // trigger key
        ZMK_MOCK_RELEASE(0,0,10) // own key released, grace opens
        ZMK_MOCK_PRESS(1,1,10)  // non-trigger key pressed DURING grace (ignored)
        ZMK_MOCK_RELEASE(1,1,10) // non-trigger key released (still ignored)
        ZMK_MOCK_RELEASE(1,0,400) // trigger released, but grace already expired -> tap
    >;
};